## conf/machine/raspberrypi0-2w-dev.conf
```bitbake
#@TYPE: Machine
#@NAME: Raspberry Pi Zero 2 W USB
#@DESCRIPTION: Raspberry Pi Zero 2W with SSH over USB and UART.

include conf/machine/raspberrypi0-2w.conf

ENABLE_DWC2_PERIPHERAL = "1"
ENABLE_UART = "1"
MACHINE_FEATURES:append = " usbgadget"
MACHINE_FEATURES:remove = " bluetooth wifi"
CMDLINE_EXTRA ?= "console=ttyAMA0,115200"
```

## conf/machine/raspberrypi0-2w-usbgadget.conf
```bitbake
#@TYPE: Machine
#@NAME: RaspberryPi0 2 W USB Gadget
#@DESCRIPTION: Raspberry Pi Zero 2 W with USB gadget networking

include conf/machine/raspberrypi0-2w.conf

ENABLE_DWC2_PERIPHERAL = "1"
CMDLINE_DWC_OTG = ""
CMDLINE_RNDIS = "modules-load=dwc2,g_ether"
```
